## config/west.yml
```yaml
manifest:
  remotes:
    - name: zmkfirmware
      url-base: https://github.com/zmkfirmware
    - name: sayu-hub
      url-base: https://github.com/sayu-hub
    # - name: sekigon-gonnoc  # <-- PAW3222
    #   url-base: https://github.com/sekigon-gonnoc
    - name: caksoylar  # <-- RGB LED
      url-base: https://github.com/caksoylar
    - name: zettaface  # <-- Input Processor Keybind
      url-base: https://github.com/zettaface
  projects:
    - name: zmk
      remote: zmkfirmware
      revision: v0.3-branch
      import: app/west.yml
    # PMW3610 driver: drivers/pmw3610 に修正版を同梱（badjeff/zmk-pmw3610-driver zmk-0.3 由来）
    # - name: zmk-driver-paw3222
    #   remote: sekigon-gonnoc
    #   revision: main
    - name: zmk-rgbled-widget
      remote: caksoylar
      revision: v0.3-branch
    - name: zmk-input-processor-keybind
      remote: zettaface
      revision: main
  self:
    path: config
```
